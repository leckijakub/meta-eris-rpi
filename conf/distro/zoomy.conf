## conf/distro/zoomy.conf
```bitbake
require conf/distro/poky.conf

DISTRO = "zoomy"
DISTRO_NAME= "Zoomy zoom zoom"
DISTRO_VERSION = "2.0"

DISTRO_FEATURES:append = " systemd"
VIRTUAL-RUNTIME:init_manager = "systemd"
DISTRO_FEATURES:BACKFILL_CONSIDERED = "sysvinit"
VIRTUAL-RUNTIME:initscripts = ""
POKY_INIT_MANAGER = "systemd"

DISTRO_FEATURES:remove = "alsa bluetooth usbgadget wifi zeroconf pci 3g nfc x11 opengl ptest multiarch wayland vulkan pulseaudio gobject-introspection-data ldconfig"

ENABLE_UART = "1"
DISABLE_VC4GRAPHICS = "1"
DISABLE_SPLASH = "1"
RPI_USE_U_BOOT = "1"
BOOT_DELAY = "0"
BOOT_DELAY_MS = "0"
DISABLE_RPI_BOOT_LOGO = "1"
CMDLINE_DEBUG = "loglevel=3"
KERNEL_MODULE_AUTOLOAD += "usbip-core usbip-host"

WKS_FILE = "eris-rpi.wks"
WIC_CREATE_EXTRA_ARGS = "\
    --rootfs-dir rootfs-main=${IMAGE_ROOTFS} \
    --rootfs-dir rootfs-data=${IMAGE_ROOTFS}/data \
    "
IMAGE_FSTYPES = "wic.bz2 wic.bmap ext4"

PREFERRED_VERSION_python3-protobuf = "3.17.3"

# include only u-boot and rpi specific bootfiles to boot partition - the kernel is provided by tftp 
IMAGE_BOOT_FILES = " \
    ${BOOTFILES_DIR_NAME}/* \
    ${@make_dtb_boot_files(d)} \
    u-boot.bin;${SDIMG_KERNELIMAGE} \
    boot.scr \
"
```

## conf/layer.conf
```bitbake
# We have a conf and classes directory, append to BBPATH
BBPATH .= ":${LAYERDIR}"

# We have a recipes directory containing .bb and .bbappend files, add to BBFILES
BBFILES += "${LAYERDIR}/recipes*/*/*.bb \
            ${LAYERDIR}/recipes*/*/*.bbappend"

BBFILE_COLLECTIONS += "eris-rpi"
BBFILE_PATTERN_eris-rpi := "^${LAYERDIR}/"
BBFILE_PRIORITY_eris-rpi = "10"

LAYERSERIES_COMPAT_eris-rpi = "mickledore"
LAYERDEPENDS_eris-rpi = "core raspberrypi"
```

## conf/machine/eris-beacon-baseboard.conf
```bitbake
require conf/machine/raspberrypi0-wifi.conf

MACHINEOVERRIDES =. "raspberrypi0-wifi:"

MACHINE_FEATURES:remove = "wifi bluetooth alsa touchscreen"

# Remove wireless communication features
BAD_RECOMMENDATIONS += "\
    linux-firmware-rpidistro-bcm43430 \
    bluez-firmware-rpidistro-bcm43430a1-hcd \
"
```

## wic/eris-rpi.wks
```
# short-description: Create Raspberry Pi SD card image
# long-description: Creates a partitioned SD card image for use with
# Raspberry Pi. Boot files are located in the first vfat partition.

part /boot/bootpart --source bootimg-partition --ondisk mmcblk0 --fstype=vfat --label boot --active --align 4096 --fixed-size 1024
# /nfs/exports/beacon_root
```
